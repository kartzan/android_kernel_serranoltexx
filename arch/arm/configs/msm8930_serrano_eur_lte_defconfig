## arch/arm/configs/msm8930_serrano_eur_lte_defconfig
```kconfig
CONFIG_MACH_SERRANO_EUR_LTE=y
CONFIG_BCM2079X_NFC_I2C=y
CONFIG_WCNSS_CCX=y
CONFIG_2MIC_QUP_I2C=y
CONFIG_PM8921_BMS=y
CONFIG_PM8921_CHARGER=y
CONFIG_PM8921_SEC_CHARGER=y
CONFIG_SAMSUNG_LPM_MODE=y
CONFIG_USB_SWITCH_TSU6721=y
CONFIG_HID_KK_UPGRADE=y
CONFIG_CGROUP_MEM_RES_CTLR_SWAP=y
CONFIG_TMPFS_POSIX_ACL=!
CONFIG_CGROUP_DEVICE=y
CONFIG_SCHEDSTATS=!
CONFIG_ANDROID_LOW_MEMORY_KILLER=n
CONFIG_CGROUP_MEM_RES_CTLR_SWAP=y
CONFIG_WATCHDOG_NOWAYOUT=y
CONFIG_NET_CLS_CGROUP=y
CONFIG_AUTOFS4_FS=m
CONFIG_NETPRIO_CGROUP=y
CONFIG_BT_HCIUART=y
CONFIG_AUDIT=n
CONFIG_DUMMY=n
CONFIG_CGROUP_MEM_RES_CTLR_KMEM=y
CONFIG_CGROUP_PERF=y
CONFIG_FANOTIFY=y
CONFIG_BLK_CGROUP=y
CONFIG_DEVTMPFS=y
CONFIG_CHECKPOINT_RESTORE=y
CONFIG_BT_RFCOMM=y
CONFIG_TMPFS_XATTR=y
CONFIG_FHANDLE=y
CONFIG_SCHED_DEBUG=y
CONFIG_ANDROID_PARANOID_NETWORK=n
CONFIG_NETFILTER_NETLINK_ACCT=y
CONFIG_VT=y
CONFIG_SECCOMP=y
CONFIG_RTC_DRV_CMOS=y
CONFIG_SECURITY_SELINUX_BOOTPARAM=y
CONFIG_AUTOFS4_FS=y
CONFIG_DEVTMPFS_MOUNT=y
CONFIG_TMPFS_POSIX_ACL=y
CONFIG_SCHEDSTATS=y
CONFIG_NETFILTER_XT_MATCH_NFACCT=y
CONFIG_BT_HCIUART_H4=y
```
